#include "servo_manager.h"

// Extern declarations for the HAL timer handles generated by CubeMX
extern TIM_HandleTypeDef htim2;
extern TIM_HandleTypeDef htim3;

void Servo_Init(void) {
    // Start PWM signals for TIM2 (Servos 1-4)
    HAL_TIM_PWM_Start(&htim2, TIM_CHANNEL_2); // SERVO_1 (PA1)
    HAL_TIM_PWM_Start(&htim2, TIM_CHANNEL_3); // SERVO_2 (PA2)
    HAL_TIM_PWM_Start(&htim2, TIM_CHANNEL_4); // SERVO_3 (PA3)
    HAL_TIM_PWM_Start(&htim2, TIM_CHANNEL_1); // SERVO_4 (PA5)

    // Start PWM signals for TIM3 (Servo 5)
    HAL_TIM_PWM_Start(&htim3, TIM_CHANNEL_1); // SERVO_5 (PA6)

    // Set all to center position (1500us) initially
    Servo_SetPulse(SERVO_1, 1500);
    Servo_SetPulse(SERVO_2, 1500);
    Servo_SetPulse(SERVO_3, 1500);
    Servo_SetPulse(SERVO_4, 1500);
    Servo_SetPulse(SERVO_5, 1500);
}

void Servo_SetPulse(Servo_ID_t servo_id, uint16_t pulse_us) {
    // Assuming Timer Clock is 100MHz and Prescaler is 99 (1 tick = 1us)
    switch(servo_id) {
        case SERVO_1: __HAL_TIM_SET_COMPARE(&htim2, TIM_CHANNEL_2, pulse_us); break;
        case SERVO_2: __HAL_TIM_SET_COMPARE(&htim2, TIM_CHANNEL_3, pulse_us); break;
        case SERVO_3: __HAL_TIM_SET_COMPARE(&htim2, TIM_CHANNEL_4, pulse_us); break;
        case SERVO_4: __HAL_TIM_SET_COMPARE(&htim2, TIM_CHANNEL_1, pulse_us); break;
        case SERVO_5: __HAL_TIM_SET_COMPARE(&htim3, TIM_CHANNEL_1, pulse_us); break;
    }
}

void Servo_SetAngle(Servo_ID_t servo_id, float angle) {
    // Basic mapping: 0 deg = 500us, 180 deg = 2500us (Adjust based on your servos)
    if (angle < 0.0f) angle = 0.0f;
    if (angle > 180.0f) angle = 180.0f;
    
    uint16_t pulse = (uint16_t)(500.0f + (angle / 180.0f) * 2000.0f);
    Servo_SetPulse(servo_id, pulse);
}
